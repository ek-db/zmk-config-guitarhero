/*
 * Copyright (c) 2020 The ZMK Contributors
 *
 * SPDX-License-Identifier: MIT
 */

#include <behaviors.dtsi>
#include <dt-bindings/zmk/bt.h>
#include <dt-bindings/zmk/keys.h>

/ {
    keymap {
        compatible = "zmk,keymap";

        default_layer {
            display-name = "frets";
            bindings = <
&kp Q  &kp W  &kp E  &kp R  &kp T  &kp Y  &kp U  &lt 1 I  &kp B
            >;
        };

        layer_1 {
            bindings = <
&bootloader  &trans  &bt BT_CLR_ALL  &bt BT_NXT  &bt BT_PRV  &trans  &trans  &trans  &trans
            >;
        };
    };
};
