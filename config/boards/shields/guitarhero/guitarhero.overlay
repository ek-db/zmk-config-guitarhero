/ { 
    chosen { 
        zmk,kscan = &kscan_direct;

     };

     kscan_direct: kscan_direct {
        compatible = "zmk,kscan-gpio-direct";

        input-gpios =
            <&gpio0 6 (GPIO_ACTIVE_LOW | GPIO_PULL_UP)>,
            <&gpio0 8 (GPIO_ACTIVE_LOW | GPIO_PULL_UP)>,
            <&gpio0 17 (GPIO_ACTIVE_LOW | GPIO_PULL_UP)>,
            <&gpio0 20 (GPIO_ACTIVE_LOW | GPIO_PULL_UP)>,
            <&gpio0 22 (GPIO_ACTIVE_LOW | GPIO_PULL_UP)>,
            <&gpio0 24 (GPIO_ACTIVE_LOW | GPIO_PULL_UP)>,
            <&gpio1 0 (GPIO_ACTIVE_LOW | GPIO_PULL_UP)>,
            <&gpio0 11 (GPIO_ACTIVE_LOW | GPIO_PULL_UP)>,
            <&gpio1 4 (GPIO_ACTIVE_LOW | GPIO_PULL_UP)>,
            <&gpio1 6 (GPIO_ACTIVE_LOW | GPIO_PULL_UP)>
            ;

      };



 };
